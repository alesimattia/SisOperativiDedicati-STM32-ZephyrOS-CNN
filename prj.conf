## CMakeLists.txt
```
cmake_minimum_required(VERSION 3.20.0)

find_package(Zephyr REQUIRED HINTS $ENV{ZEPHYR_BASE})
project(person_detector)

# These samples use local static initialization. Since Zephyr doesn't support the
# C++ ABI for thread-safe initialization of local statics and the constructors don't
# appear to require thread safety, we turn it off in the C++ compiler.
set(NO_THREADSAFE_STATICS $<TARGET_PROPERTY:compiler-cpp,no_threadsafe_statics>)
zephyr_compile_options($<$<COMPILE_LANGUAGE:CXX>:${NO_THREADSAFE_STATICS}>)

file(GLOB app_sources src/*)
target_sources(app PRIVATE ${app_sources})
```

## sample.yaml
```
sample:
  description: TensorFlow Micro Person Detector
  name: person_detector
common:
  tags: tensorflow
  modules:
    - tflite-micro
  harness: console
  harness_config:
    type: multi_line
    ordered: false
```

## prj.conf
```kconfig
# Copyright 2019 The TensorFlow Authors. All Rights Reserved.
#
# Licensed under the Apache License, Version 2.0 (the "License");
# you may not use this file except in compliance with the License.
# You may obtain a copy of the License at
#
#    http://www.apache.org/licenses/LICENSE-2.0
#
# Unless required by applicable law or agreed to in writing, software
# distributed under the License is distributed on an "AS IS" BASIS,
# WITHOUT WARRANTIES OR CONDITIONS OF ANY KIND, either express or implied.
# See the License for the specific language governing permissions and
# limitations under the License.
# ==============================================================================s
CONFIG_CPP=y
CONFIG_STD_CPP17=y
CONFIG_LIB_CPLUSPLUS=y
CONFIG_REQUIRES_FULL_LIBCPP=y

CONFIG_MAIN_STACK_SIZE=2048
CONFIG_TENSORFLOW_LITE_MICRO=y

CONFIG_STDOUT_CONSOLE=y
```

## src/main.c
```c
/*
 * Copyright (c) 2018 Bosch Sensortec GmbH
 *
 * SPDX-License-Identifier: Apache-2.0
 */

#include <stdio.h>

#include <zephyr/kernel.h>
#include <zephyr/device.h>
#include <zephyr/drivers/gpio.h>                                                                                                                                                     
#include <zephyr/drivers/spi.h>



int main(void)
{
	int c = 0;
	printf("First Program\n");

	while(1){
		k_sleep(K_MSEC(1000));
		c++;
		printf("Running since %d seconds\n", c );
	}
	return 0;
}
```

## src/main.cc
```c
/**
----------------------------------------------------------------------
@author: Alesi Mattia s1114418
@project: CNN Person Detector su ZephyrOS
@cite: TensorFlow Lite for Microcontroller
----------------------------------------------------------------------
**/

#include "tensorflow/lite/micro/examples/person_detection/main_functions.h"

// This is the default main used on systems that have the standard C entry
// point. Other devices (for example FreeRTOS or ESP32) that have different
// requirements for entry code (like an app_main function) should specialize
// this main.cc file in a target-specific subfolder.
int main(int argc, char* argv[]) {
  setup();
  while (true) {
    loop();
  }
  return 0; //richiesto da specifiche C++ ZephyrOS
}
```

## src/main.cpp
```c
// #include <kernel.h>
// #include <zephyr/kernel.h>
// #include <zephyr/device.h>
// #include <zephyr/devicetree.h>
// #include <zephyr/drivers/gpio.h>                                                                                                                                                     
// #include <zephyr/drivers/spi.h>
// #include <zephyr/drivers/display.h>
// #include <zephyr/drivers/sensor.h>
// #include <lvgl.h>
// #include <stdio.h>
// #include <string.h>
// #include <iostream>

#include <iostream>
#include "cppflow.h"

//using namespace std;

/* int main(int argc, char *argv[])
{
	int c = 0;
	printf("First Program\n");

	while(1){
		k_sleep(K_MSEC(1000));
		c++;
		printf("Running since %d seconds\n", c );
	}

	return 0; //required for Zephyr C++ implementation
} */

int main(int argc, char *argv[]) {

    // Create a tensor from a list, a = [1.0, 2.0, 3.0]
    auto a = cppflow::tensor({1.0, 2.0, 3.0});
    // Create a tensor of shape 3 filled with 1.0, b = [1.0, 1.0, 1.0]
    auto b = cppflow::fill({3}, 1.0);

    std::cout << a + b << std::endl;

    return 0;
}
```

## src/detection_responder_test.cc
```c
/* Copyright 2019 The TensorFlow Authors. All Rights Reserved.

Licensed under the Apache License, Version 2.0 (the "License");
you may not use this file except in compliance with the License.
You may obtain a copy of the License at

    http://www.apache.org/licenses/LICENSE-2.0

Unless required by applicable law or agreed to in writing, software
distributed under the License is distributed on an "AS IS" BASIS,
WITHOUT WARRANTIES OR CONDITIONS OF ANY KIND, either express or implied.
See the License for the specific language governing permissions and
limitations under the License.
==============================================================================*/

#include "tensorflow/lite/micro/examples/person_detection/detection_responder.h"

#include "tensorflow/lite/micro/testing/micro_test.h"


void TF_LITE_MICRO_TEST(){
  // This will have external side-effects (like printing to the debug console
  // or lighting an LED) that are hard to observe, so the most we can do is
  // make sure the call doesn't crash.
  RespondToDetection(-100, 100);
  RespondToDetection(100, 50);
}
```

## src/image_provider_test.cc
```c
/* Copyright 2022 The TensorFlow Authors. All Rights Reserved.

Licensed under the Apache License, Version 2.0 (the "License");
you may not use this file except in compliance with the License.
You may obtain a copy of the License at

    http://www.apache.org/licenses/LICENSE-2.0

Unless required by applicable law or agreed to in writing, software
distributed under the License is distributed on an "AS IS" BASIS,
WITHOUT WARRANTIES OR CONDITIONS OF ANY KIND, either express or implied.
See the License for the specific language governing permissions and
limitations under the License.
==============================================================================*/

#include "tensorflow/lite/micro/examples/person_detection/image_provider.h"

#include <limits>

#include "tensorflow/lite/c/common.h"
#include "tensorflow/lite/micro/examples/person_detection/model_settings.h"
#include "tensorflow/lite/micro/testing/micro_test.h"


void TF_LITE_MICRO_TEST() {
  int8_t image_data[kMaxImageSize];
  TfLiteStatus get_status =
      GetImage(kNumCols, kNumRows, kNumChannels, image_data);
  TF_LITE_MICRO_EXPECT_EQ(kTfLiteOk, get_status);

  // Make sure we can read all of the returned memory locations.
  uint32_t total = 0;
  for (int i = 0; i < kMaxImageSize; ++i) {
    total += image_data[i];
  }
  (void)total;
}
```

## src/layer.cpp
```c
/*
 * Copyright (c) 2016 Robert W. Rose
 * Copyright (c) 2018 Paul Maevskikh
 *
 * MIT License, see LICENSE file.
 */
#include "keras/layer.h"

namespace keras {

LayerBase::~LayerBase() = default;

} // namespace keras
```

## src/main_functions.cc
```c
/* Copyright 2022 The TensorFlow Authors. All Rights Reserved.

Licensed under the Apache License, Version 2.0 (the "License");
you may not use this file except in compliance with the License.
You may obtain a copy of the License at

		http://www.apache.org/licenses/LICENSE-2.0

Unless required by applicable law or agreed to in writing, software
distributed under the License is distributed on an "AS IS" BASIS,
WITHOUT WARRANTIES OR CONDITIONS OF ANY KIND, either express or implied.
See the License for the specific language governing permissions and
limitations under the License.
==============================================================================*/

#include "tensorflow/lite/micro/examples/person_detection/main_functions.h"

#include "tensorflow/lite/micro/examples/person_detection/detection_responder.h"
#include "tensorflow/lite/micro/examples/person_detection/image_provider.h"
#include "tensorflow/lite/micro/examples/person_detection/model_settings.h"
#include "tensorflow/lite/micro/micro_interpreter.h"
#include "tensorflow/lite/micro/micro_log.h"
#include "tensorflow/lite/micro/micro_mutable_op_resolver.h"
#include "tensorflow/lite/micro/models/person_detect_model_data.h"
#include "tensorflow/lite/micro/system_setup.h"
#include "tensorflow/lite/schema/schema_generated.h"

// Globals, used for compatibility with Arduino-style sketches.
namespace {
	const tflite::Model* model = nullptr;
	tflite::MicroInterpreter* interpreter = nullptr;
	TfLiteTensor* input = nullptr;

	// In order to use optimized tensorflow lite kernels, a signed int8_t quantized
	// model is preferred over the legacy unsigned model format. This means that
	// throughout this project, input images must be converted from unisgned to
	// signed format. The easiest and quickest way to convert from unsigned to
	// signed 8-bit integers is to subtract 128 from the unsigned value to get a
	// signed value.

	// An area of memory to use for input, output, and intermediate arrays.
	constexpr int kTensorArenaSize = 136 * 1024;
	alignas(16) static uint8_t tensor_arena[kTensorArenaSize];
}  // namespace

// The name of this function is important for Arduino compatibility.
void setup() {
	tflite::InitializeTarget();

	// Map the model into a usable data structure. This doesn't involve any
	// copying or parsing, it's a very lightweight operation.
	model = tflite::GetModel(g_person_detect_model_data);
	if (model->version() != TFLITE_SCHEMA_VERSION) {
		MicroPrintf(
				"Model provided is schema version %d not equal "
				"to supported version %d.",
				model->version(), TFLITE_SCHEMA_VERSION);
		return;
	}

	// Pull in only the operation implementations we need.
	// This relies on a complete list of all the ops needed by this graph.

	// NOLINTNEXTLINE(runtime-global-variables)
	static tflite::MicroMutableOpResolver<5> micro_op_resolver;
	micro_op_resolver.AddAveragePool2D(tflite::Register_AVERAGE_POOL_2D_INT8());
	micro_op_resolver.AddConv2D(tflite::Register_CONV_2D_INT8());
	micro_op_resolver.AddDepthwiseConv2D(
			tflite::Register_DEPTHWISE_CONV_2D_INT8());
	micro_op_resolver.AddReshape();
	micro_op_resolver.AddSoftmax(tflite::Register_SOFTMAX_INT8());

	// Build an interpreter to run the model with.
	// NOLINTNEXTLINE(runtime-global-variables)
	static tflite::MicroInterpreter static_interpreter(
			model, micro_op_resolver, tensor_arena, kTensorArenaSize);
	interpreter = &static_interpreter;

	// Allocate memory from the tensor_arena for the model's tensors.
	TfLiteStatus allocate_status = interpreter->AllocateTensors();
	if (allocate_status != kTfLiteOk) {
		MicroPrintf("AllocateTensors() failed");
		return;
	}

	// Get information about the memory area to use for the model's input.
	input = interpreter->input(0);
}

// The name of this function is important for Arduino compatibility.
void loop() {
	// Get image from provider.
	if (kTfLiteOk !=
			GetImage(kNumCols, kNumRows, kNumChannels, input->data.int8)) {
		MicroPrintf("Image capture failed.");
	}

	// Run the model on this input and make sure it succeeds.
	if (kTfLiteOk != interpreter->Invoke()) {
		MicroPrintf("Invoke failed.");
	}

	TfLiteTensor* output = interpreter->output(0);

	// Process the inference results.
	int8_t person_score = output->data.uint8[kPersonIndex];
	int8_t no_person_score = output->data.uint8[kNotAPersonIndex];
	RespondToDetection(person_score, no_person_score);
}
```

## src/main_functions.h
```c
/* Copyright 2019 The TensorFlow Authors. All Rights Reserved.

Licensed under the Apache License, Version 2.0 (the "License");
you may not use this file except in compliance with the License.
You may obtain a copy of the License at

    http://www.apache.org/licenses/LICENSE-2.0

Unless required by applicable law or agreed to in writing, software
distributed under the License is distributed on an "AS IS" BASIS,
WITHOUT WARRANTIES OR CONDITIONS OF ANY KIND, either express or implied.
See the License for the specific language governing permissions and
limitations under the License.
==============================================================================*/

#ifndef TENSORFLOW_LITE_MICRO_EXAMPLES_PERSON_DETECTION_MAIN_FUNCTIONS_H_
#define TENSORFLOW_LITE_MICRO_EXAMPLES_PERSON_DETECTION_MAIN_FUNCTIONS_H_

// Expose a C friendly interface for main functions.
#ifdef __cplusplus
extern "C" {
    #endif

    // Initializes all data needed for the example. The name is important, and needs
    // to be setup() for Arduino compatibility.
    void setup();

    // Runs one iteration of data gathering and inference. This should be called
    // repeatedly from the application code. The name needs to be loop() for Arduino
    // compatibility.
    void loop();

    #ifdef __cplusplus
}
#endif

#endif  // TENSORFLOW_LITE_MICRO_EXAMPLES_PERSON_DETECTION_MAIN_FUNCTIONS_H_
```

## src/person_detection_test.cc
```c
/* Copyright 2022 The TensorFlow Authors. All Rights Reserved.

Licensed under the Apache License, Version 2.0 (the "License");
you may not use this file except in compliance with the License.
You may obtain a copy of the License at

		http://www.apache.org/licenses/LICENSE-2.0

Unless required by applicable law or agreed to in writing, software
distributed under the License is distributed on an "AS IS" BASIS,
WITHOUT WARRANTIES OR CONDITIONS OF ANY KIND, either express or implied.
See the License for the specific language governing permissions and
limitations under the License.
==============================================================================*/

#include "tensorflow/lite/c/common.h"
#include "tensorflow/lite/micro/examples/person_detection/model_settings.h"
#include "tensorflow/lite/micro/examples/person_detection/testdata/no_person_image_data.h"
#include "tensorflow/lite/micro/examples/person_detection/testdata/person_image_data.h"
#include "tensorflow/lite/micro/micro_interpreter.h"
#include "tensorflow/lite/micro/micro_log.h"
#include "tensorflow/lite/micro/micro_mutable_op_resolver.h"
#include "tensorflow/lite/micro/models/person_detect_model_data.h"
#include "tensorflow/lite/micro/testing/micro_test.h"
#include "tensorflow/lite/schema/schema_generated.h"

// Create an area of memory to use for input, output, and intermediate arrays.
#if defined(XTENSA) && defined(VISION_P6)
	constexpr int tensor_arena_size = 352 * 1024;
#else
	constexpr int tensor_arena_size = 136 * 1024;
#endif  // defined(XTENSA) && defined(VISION_P6)
uint8_t tensor_arena[tensor_arena_size];


void TF_LITE_MICRO_TEST(){
	// Map the model into a usable data structure. This doesn't involve any
	// copying or parsing, it's a very lightweight operation.
	const tflite::Model* model = ::tflite::GetModel(g_person_detect_model_data);
	if (model->version() != TFLITE_SCHEMA_VERSION) {
		MicroPrintf(
				"Model provided is schema version %d not equal "
				"to supported version %d.\n",
				model->version(), TFLITE_SCHEMA_VERSION);
	}

	// Pull in only the operation implementations we need.
	// This relies on a complete list of all the ops needed by this graph.
	// An easier approach is to just use the AllOpsResolver, but this will
	// incur some penalty in code space for op implementations that are not
	// needed by this graph.
	tflite::MicroMutableOpResolver<5> micro_op_resolver;
	micro_op_resolver.AddAveragePool2D(tflite::Register_AVERAGE_POOL_2D_INT8());
	micro_op_resolver.AddConv2D(tflite::Register_CONV_2D_INT8());
	micro_op_resolver.AddDepthwiseConv2D(
			tflite::Register_DEPTHWISE_CONV_2D_INT8());
	micro_op_resolver.AddReshape();
	micro_op_resolver.AddSoftmax(tflite::Register_SOFTMAX_INT8());

	// Build an interpreter to run the model with.
	tflite::MicroInterpreter interpreter(model, micro_op_resolver, tensor_arena,
																			 tensor_arena_size);
	interpreter.AllocateTensors();

	// Get information about the memory area to use for the model's input.
	TfLiteTensor* input = interpreter.input(0);

	// Make sure the input has the properties we expect.
	TF_LITE_MICRO_EXPECT(input != nullptr);
	TF_LITE_MICRO_EXPECT_EQ(4, input->dims->size);
	TF_LITE_MICRO_EXPECT_EQ(1, input->dims->data[0]);
	TF_LITE_MICRO_EXPECT_EQ(kNumRows, input->dims->data[1]);
	TF_LITE_MICRO_EXPECT_EQ(kNumCols, input->dims->data[2]);
	TF_LITE_MICRO_EXPECT_EQ(kNumChannels, input->dims->data[3]);
	TF_LITE_MICRO_EXPECT_EQ(kTfLiteInt8, input->type);

	// Copy an image with a person into the memory area used for the input.
	TFLITE_DCHECK_EQ(input->bytes, static_cast<size_t>(g_person_image_data_size));
	memcpy(input->data.int8, g_person_image_data, input->bytes);

	// Run the model on this input and make sure it succeeds.
	TfLiteStatus invoke_status = interpreter.Invoke();
	if (invoke_status != kTfLiteOk) {
		MicroPrintf("Invoke failed\n");
	}
	TF_LITE_MICRO_EXPECT_EQ(kTfLiteOk, invoke_status);

	// Get the output from the model, and make sure it's the expected size and
	// type.
	TfLiteTensor* output = interpreter.output(0);
	TF_LITE_MICRO_EXPECT_EQ(2, output->dims->size);
	TF_LITE_MICRO_EXPECT_EQ(1, output->dims->data[0]);
	TF_LITE_MICRO_EXPECT_EQ(kCategoryCount, output->dims->data[1]);
	TF_LITE_MICRO_EXPECT_EQ(kTfLiteInt8, output->type);

	// Make sure that the expected "Person" score is higher than the other class.
	int8_t person_score = output->data.int8[kPersonIndex];
	int8_t no_person_score = output->data.int8[kNotAPersonIndex];
	MicroPrintf("person data.  person score: %d, no person score: %d\n",
							person_score, no_person_score);
	TF_LITE_MICRO_EXPECT_GT(person_score, no_person_score);

	memcpy(input->data.int8, g_no_person_image_data, input->bytes);

	// Run the model on this "No Person" input.
	invoke_status = interpreter.Invoke();
	if (invoke_status != kTfLiteOk) {
		MicroPrintf("Invoke failed\n");
	}
	TF_LITE_MICRO_EXPECT_EQ(kTfLiteOk, invoke_status);

	// Get the output from the model, and make sure it's the expected size and
	// type.
	output = interpreter.output(0);
	TF_LITE_MICRO_EXPECT_EQ(2, output->dims->size);
	TF_LITE_MICRO_EXPECT_EQ(1, output->dims->data[0]);
	TF_LITE_MICRO_EXPECT_EQ(kCategoryCount, output->dims->data[1]);
	TF_LITE_MICRO_EXPECT_EQ(kTfLiteInt8, output->type);

	// Make sure that the expected "No Person" score is higher.
	person_score = output->data.int8[kPersonIndex];
	no_person_score = output->data.int8[kNotAPersonIndex];
	MicroPrintf("no person data.  person score: %d, no person score: %d\n",
							person_score, no_person_score);
	TF_LITE_MICRO_EXPECT_GT(no_person_score, person_score);

	MicroPrintf("Ran successfully\n");
}
```
